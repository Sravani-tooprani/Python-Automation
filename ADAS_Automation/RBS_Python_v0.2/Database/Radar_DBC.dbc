VERSION ""

NS_ :

BS_:

BU_: Radar
VAL_TABLE_ Vt_ACC_SIG_Status 6 "Standstillwait" 5 "Standstill" 4 "Failure" 3 "Suspend" 2 "Active" 1 "Passive" 0 "Init" ;
VAL_TABLE_ vt_ACC_display_signal 3 "Check_Gear_position" 2 "Vehicle speed too low" 1 "Reserved" 0 "Reserved" ;

BO_ 336 ACC_status: 1 Vector__XXX
 SG_ ACC_sig_status : 2|3@1+ (1,0) [0|7] "" Vector__XXX
 SG_ ACC_disp_signal : 0|2@1+ (1,0) [0|3] "" Vector__XXX

EV_ env_tester_present_on_or_off: 0 [0|1] "" 0 1 DUMMY_NODE_VECTOR3 Vector__XXX;

EV_ env_variant_coading_done: 0 [0|1] "" 0 2 DUMMY_NODE_VECTOR3 Vector__XXX;

VAL_ 336 ACC_sig_status 6 "Standstillwait" 5 "Standstill" 4 "Failure" 3 "Suspend" 2 "Active" 1 "Passive" 0 "Init" ;
VAL_ 336 ACC_disp_signal 3 "Check_Gear_position" 2 "Vehicle speed too low" 1 "Reserved" 0 "Reserved" ;
