VERSION ""

NS_ :

BS_:

BU_: IPC BCM

BO_ 256 BCMMessage: 8 BCM
 SG_ BCM_Signal : 0|3@1+ (1,0) [0|7] "" Vector__XXX

BA_DEF_ BU_  "NodeLayerModule" STRING ;
BA_DEF_ SG_  "ILUsed" ENUM  "YES","NO";
BA_DEF_ BO_  "GenMsgSendType" ENUM  "FixedPeriodic","EventPeriodic","Event";
BA_DEF_ BO_  "GenMsgCycleTime" INT 0 20000;
BA_DEF_DEF_  "NodeLayerModule" "CANoeILNLVector.dll";
BA_DEF_DEF_  "ILUsed" "YES";
BA_DEF_DEF_  "GenMsgSendType" "FixedPeriodic";
BA_DEF_DEF_  "GenMsgCycleTime" 50;
