VERSION ""

NS_ :

BS_:

BU_: IPC BCM

BO_ 256 BCMMessage: 8 BCM
 SG_ BCM_Signal : 0|3@1+ (1,0) [0|7] "" Vector__XXX
